AUTOSAR XML (schema 4-2-1)
package /ActiveEcuC
  module config Gpt: implementation-config-variant=VARIANT-PRE-COMPILE, module-description=Gpt_Impl
    GptChannelConfigSet
      3 x GptChannelConfiguration, all with GptChannelMode=GPT_CH_MODE_CONTINUOUS, GptLPitEnReloadOnTrigger=false, GptLPitEnStartOnTrigger=false, GptFreezeEnable=true, GptEnableWakeup=false:
        GptChannelConfiguration: GptChannelId=0, GptHwChannel=LPIT_0_CH_0, GptChannelTickFrequency=4000000, GptLPitIsExternalTrigger=true, GptLPitEnStopOnInterrupt=true, GptChannelTickValueMax=4294967295, GptLPitTriggerChannels=Channel_15_Trigger_Source, GptNotification=Gpt_1ms, GptChannelClkSrcRef=GptClockReferencePoint
        GptChannelConfiguration_LPtmr: GptChannelId=1, GptHwChannel=LPTMR_0_CH_0, GptChannelTickFrequency=12000000, GptLPitIsExternalTrigger=false, GptLPitEnStopOnInterrupt=false, GptChannelTickValueMax=65535, GptLptmrChannelClkSrc=PCC_LPTMR0, GptLptmrPrescaler=2, GptLptmrPrescaler_Alternate=2, GptNotification=Gpt_Lpmtr_5ms, GptChannelClkSrcRef=GptClockReferencePoint_LPMTR
        GptChannelConfiguration_FTM0_CH0_CH1: GptChannelId=2, GptHwChannel=FTM_0_CH_0, GptChannelTickFrequency=8000000, GptLPitIsExternalTrigger=false, GptLPitEnStopOnInterrupt=false, GptChannelTickValueMax=65535, GptFtmChannelClkSrc=EXTERNAL_CLOCK, GptFtmPrescaler=1, GptFtmPrescaler_Alternate=1, GptNotification=Gpt_FTM0_8ms, GptChannelClkSrcRef=GptClockReferencePoint_FTM0
    22 x GptHwConfiguration:
      GptHwConfiguration: GptIsrHwId=LPIT_0_CH_0, GptIsrEnable=true, GptModuleIsUsed=true
      GptHwConfiguration_{1..3}: GptIsrHwId=LPIT_0_CH_{1..3}, GptIsrEnable=false, GptModuleIsUsed=false
      GptHwConfiguration_4: GptIsrHwId=FTM_0_CH_0_CH_1, GptIsrEnable=true, GptModuleIsUsed=true
      GptHwConfiguration_5: GptIsrHwId=FTM_0_CH_2_CH_3, GptIsrEnable=false, GptModuleIsUsed=false
      GptHwConfiguration_6: GptIsrHwId=FTM_0_CH_4_CH_5, GptIsrEnable=false, GptModuleIsUsed=false
      GptHwConfiguration_7: GptIsrHwId=FTM_0_CH_6_CH_7, GptIsrEnable=false, GptModuleIsUsed=false
      GptHwConfiguration_8: GptIsrHwId=FTM_1_CH_0_CH_1, GptIsrEnable=false, GptModuleIsUsed=false
      GptHwConfiguration_9: GptIsrHwId=FTM_1_CH_2_CH_3, GptIsrEnable=false, GptModuleIsUsed=false
      GptHwConfiguration_10: GptIsrHwId=FTM_1_CH_4_CH_5, GptIsrEnable=false, GptModuleIsUsed=false
      GptHwConfiguration_11: GptIsrHwId=FTM_1_CH_6_CH_7, GptIsrEnable=false, GptModuleIsUsed=false
      GptHwConfiguration_12: GptIsrHwId=FTM_2_CH_0_CH_1, GptIsrEnable=false, GptModuleIsUsed=false
      GptHwConfiguration_13: GptIsrHwId=FTM_2_CH_2_CH_3, GptIsrEnable=false, GptModuleIsUsed=false
      GptHwConfiguration_14: GptIsrHwId=FTM_2_CH_4_CH_5, GptIsrEnable=false, GptModuleIsUsed=false
      GptHwConfiguration_15: GptIsrHwId=FTM_2_CH_6_CH_7, GptIsrEnable=false, GptModuleIsUsed=false
      GptHwConfiguration_16: GptIsrHwId=FTM_3_CH_0_CH_1, GptIsrEnable=false, GptModuleIsUsed=false
      GptHwConfiguration_17: GptIsrHwId=FTM_3_CH_2_CH_3, GptIsrEnable=false, GptModuleIsUsed=false
      GptHwConfiguration_18: GptIsrHwId=FTM_3_CH_4_CH_5, GptIsrEnable=false, GptModuleIsUsed=false
      GptHwConfiguration_19: GptIsrHwId=FTM_3_CH_6_CH_7, GptIsrEnable=false, GptModuleIsUsed=false
      GptHwConfiguration_20: GptIsrHwId=LPTMR_0_CH_0, GptIsrEnable=true, GptModuleIsUsed=true
      GptHwConfiguration_21: GptIsrHwId=SRTC_0_CH_0, GptIsrEnable=false, GptModuleIsUsed=false
    GptConfigurationOfOptApiServices:
      GptDeinitApi = true
      GptEnableDisableNotificationApi = true
      GptTimeElapsedApi = true
      GptTimeRemainingApi = true
      GptVersionInfoApi = true
      GptWakeupFunctionalityApi = true
      GptPredefTimerFunctionalityApi = false
    GptNonAUTOSAR: GptEnableUserModeSupport=false, GptEnableDualClockMode=false, GptChangeNextTimeoutValueApi=false, GptEnableTriggers=true
    GptDriverConfiguration:
      GptDevErrorDetect = true
      GptPredefTimer100us32bitEnable = false
      GptPredefTimer1usEnablingGrade = GPT_PREDEF_TIMER_1US_16BIT_ENABLED
      GptReportWakeupSource = true
      GptRegisterLockingMode = NO_REGISTER_LOCKING
      3 x GptClockReferencePoint:
        GptClockReferencePoint: GptClockReference=McuClockReferencePoint_LPIT
        GptClockReferencePoint_LPMTR: GptClockReference=McuClockReferencePoint_LPtmr
        GptClockReferencePoint_FTM0: GptClockReference=McuClockReferencePoint_FTM0
    GptPredefTimerConfiguration
    CommonPublishedInformation:
      ArReleaseMajorVersion = 4
      ArReleaseMinorVersion = 2
      ArReleaseRevisionVersion = 2
      ModuleId = 100
      SwMajorVersion = 1
      SwMinorVersion = 0
      SwPatchVersion = 1
      VendorId = 43
