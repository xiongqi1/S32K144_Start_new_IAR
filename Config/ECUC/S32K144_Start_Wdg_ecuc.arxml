AUTOSAR XML (schema 4-2-1)
package /ActiveEcuC
  module config Wdg: implementation-config-variant=VARIANT-PRE-COMPILE, module-description=Wdg_Impl
    WdgGeneral:
      WdgDevErrorDetect = false
      WdgDisableAllowed = true
      WdgEnableUserModeSupport = false
      WdgIndex = 0
      WdgIndex{1..3} = {1..3}
      WdgInitialTimeout = 1
      WdgMaxTimeout = 65
      WdgRunArea = ROM
      WdgTriggerLocation = NULL_PTR
      WdgCallbackNotification0 = NULL_PTR
      WdgVersionInfoApi = true
      NonAutosar: WdgDisableDemReportErrorStatus=false
    WdgSettingsConfig: WdgInstance=WDOG0, WdgDefaultMode=WDGIF_FAST_MODE, WdgInterruptContentEnable=true, WdgExternalTriggerCounterRef=GptChannelConfiguration_WDG
      WdgSettingsFast:
        WdgClockValue = 128
        WdgRunsInStopMode = false
        WdgRunsInDebugMode = false
        WdgRunsInWaitMode = false
        WdgOperationMode = Interrupt
        WdgClockSelection = LPO_Clock
        WdgTimeoutPeriod = 0.5
        WdgWindowMode = false
        WdgWindowPeriod = 0.004
        WdgPrescalerEnabled = false
        WdgAllowUpdates = true
        WdgTestMode = TestModeDisabled
        WdgClkSrcRef = WdgClockReferencePoint
      WdgSettingsOff: WdgAllowUpdates=true
      WdgSettingsSlow:
        WdgClockValue = 128
        WdgRunsInStopMode = false
        WdgRunsInDebugMode = false
        WdgRunsInWaitMode = false
        WdgOperationMode = ResetOnTimeOut
        WdgClockSelection = LPO_Clock
        WdgTimeoutPeriod = 0.01
        WdgWindowMode = false
        WdgWindowPeriod = 0.004
        WdgPrescalerEnabled = false
        WdgAllowUpdates = true
        WdgTestMode = TestModeDisabled
        WdgClkSrcRef = WdgClockReferencePoint
    WdgClockReferencePoint: WdgClockReference=McuClockReferencePoint_WDG
    WdgPublishedInformation: WdgTriggerMode=WDG_BOTH
    CommonPublishedInformation:
      ArReleaseMajorVersion = 4
      ArReleaseMinorVersion = 2
      ArReleaseRevisionVersion = 2
      ModuleId = 102
      SwMajorVersion = 1
      SwMinorVersion = 0
      SwPatchVersion = 1
      VendorId = 43
