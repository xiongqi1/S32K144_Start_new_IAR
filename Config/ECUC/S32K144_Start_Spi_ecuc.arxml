AUTOSAR XML (schema 4-2-1)
package /Spi
  module config Spi: implementation-config-variant=VARIANT-PRE-COMPILE, module-description=Spi_Impl
    CommonPublishedInformation:
      ArReleaseMajorVersion = 4
      ArReleaseMinorVersion = 2
      ArReleaseRevisionVersion = 2
      ModuleId = 83
      SwMajorVersion = 1
      SwMinorVersion = 0
      SwPatchVersion = 1
      VendorId = 43
    SpiDriver: SpiMaxChannel=6, SpiMaxJob=4, SpiMaxSequence=3
      SpiChannel_test0 (SpiChannel): SpiChannelId=0, SpiChannelType=EB, SpiDataWidth=8, SpiEbMaxLength=4, SpiIbNBuffers=1, SpiTransferStart=MSB, SpiTransferWidth=1
      SpiExternalDevice_LPSPI1_PCS3 (SpiExternalDevice):
        SpiBaudrate = 100000
        SpiBaudrateAlternate = 100000
        SpiByteSwap = FALSE
        SpiCsContinous = TRUE
        SpiCsIdentifier = PCS3
        SpiCsPolarity = LOW
        SpiDataShiftEdge = LEADING
        SpiEnableCs = true
        SpiHwUnit = CSIB1
        SpiShiftClockIdleLevel = LOW
        SpiSlaveMode = false
        SpiTimeClk2Cs = 0.0001
        SpiTimeCs2Clk = 0.0001
        SpiTimeCs2Cs = 0.0001
        SpiCsSelection = CS_VIA_PERIPHERAL_ENGINE
      SpiJob_LPSPI1_0 (SpiJob): SpiHwUnitSynchronous=SYNCHRONOUS, SpiJobId=0, SpiJobPriority=0, SpiDeviceAssignment=SpiExternalDevice_LPSPI1_PCS3
        SpiChannelList_0 (SpiChannelList): SpiChannelIndex=0, SpiChannelAssignment=SpiChannel_test0
        SpiChannelList_1 (SpiChannelList): SpiChannelIndex=1, SpiChannelAssignment=SpiChannel_test1
      SpiSequence_0 (SpiSequence): SpiInterruptibleSequence=false, SpiSequenceId=0, SpiJobAssignment=SpiJob_LPSPI1_0
      SpiChannel_test1 (SpiChannel): SpiChannelId=1, SpiChannelType=EB, SpiDataWidth=8, SpiTransferWidth=1, SpiEbMaxLength=5, SpiIbNBuffers=1, SpiTransferStart=MSB
      SpiExternalDevice_LPSPI1_PCS0 (SpiExternalDevice):
        SpiSlaveMode = false
        SpiBaudrate = 100000
        SpiBaudrateAlternate = 100000
        SpiCsIdentifier = PCS0
        SpiCsPolarity = LOW
        SpiDataShiftEdge = LEADING
        SpiEnableCs = true
        SpiHwUnit = CSIB1
        SpiShiftClockIdleLevel = LOW
        SpiTimeClk2Cs = 0.0001
        SpiTimeCs2Clk = 0.0001
        SpiTimeCs2Cs = 0.0001
        SpiCsContinous = TRUE
        SpiByteSwap = FALSE
        SpiCsSelection = CS_VIA_PERIPHERAL_ENGINE
      SpiJob_LPSPI1_1 (SpiJob): SpiJobId=1, SpiJobPriority=1, SpiHwUnitSynchronous=SYNCHRONOUS, SpiDeviceAssignment=SpiExternalDevice_LPSPI1_PCS0
        SpiChannelList_1 (SpiChannelList): SpiChannelIndex=0, SpiChannelAssignment=SpiChannel_test2
        SpiChannelList_2 (SpiChannelList): SpiChannelIndex=1, SpiChannelAssignment=SpiChannel_test3
      SpiExternalDevice_LPSPI1_PCS1 (SpiExternalDevice):
        SpiSlaveMode = false
        SpiBaudrate = 100000
        SpiBaudrateAlternate = 100000
        SpiCsIdentifier = PCS1
        SpiCsPolarity = LOW
        SpiDataShiftEdge = LEADING
        SpiEnableCs = true
        SpiHwUnit = CSIB1
        SpiShiftClockIdleLevel = LOW
        SpiTimeClk2Cs = 0.0001
        SpiTimeCs2Clk = 0.0001
        SpiTimeCs2Cs = 0.0001
        SpiCsContinous = TRUE
        SpiByteSwap = FALSE
        SpiCsSelection = CS_VIA_PERIPHERAL_ENGINE
      SpiExternalDevice_LPSPI1_PCS2 (SpiExternalDevice):
        SpiSlaveMode = false
        SpiBaudrate = 100000
        SpiBaudrateAlternate = 100000
        SpiCsIdentifier = PCS2
        SpiCsPolarity = LOW
        SpiDataShiftEdge = LEADING
        SpiEnableCs = true
        SpiHwUnit = CSIB1
        SpiShiftClockIdleLevel = LOW
        SpiTimeClk2Cs = 0.0001
        SpiTimeCs2Clk = 0.0001
        SpiTimeCs2Cs = 0.0001
        SpiCsContinous = TRUE
        SpiByteSwap = FALSE
        SpiCsSelection = CS_VIA_PERIPHERAL_ENGINE
      SpiSequence_1 (SpiSequence): SpiInterruptibleSequence=false, SpiSequenceId=1, SpiJobAssignment=SpiJob_LPSPI1_1
      SpiChannel_test2 (SpiChannel): SpiChannelId=2, SpiChannelType=EB, SpiDataWidth=8, SpiTransferWidth=1, SpiEbMaxLength=6, SpiIbNBuffers=1, SpiTransferStart=MSB
      SpiChannel_test3 (SpiChannel): SpiChannelId=3, SpiChannelType=EB, SpiDataWidth=8, SpiTransferWidth=1, SpiEbMaxLength=4, SpiIbNBuffers=1, SpiTransferStart=MSB
      SpiExternalDevice_LPSPI0_PCS0 (SpiExternalDevice):
        SpiSlaveMode = false
        SpiBaudrate = 100000
        SpiBaudrateAlternate = 100000
        SpiCsIdentifier = PCS0
        SpiCsPolarity = LOW
        SpiDataShiftEdge = LEADING
        SpiEnableCs = true
        SpiHwUnit = CSIB0
        SpiShiftClockIdleLevel = LOW
        SpiTimeClk2Cs = 0.0001
        SpiTimeCs2Clk = 0.0001
        SpiTimeCs2Cs = 0.0001
        SpiCsContinous = TRUE
        SpiByteSwap = FALSE
        SpiCsSelection = CS_VIA_PERIPHERAL_ENGINE
      SpiJob_LPSPI0_0 (SpiJob): SpiJobId=2, SpiJobPriority=2, SpiHwUnitSynchronous=ASYNCHRONOUS, SpiDeviceAssignment=SpiExternalDevice_LPSPI0_PCS0
        SpiChannelList_0 (SpiChannelList): SpiChannelIndex=0, SpiChannelAssignment=SpiChannel_test4
      SpiExternalDevice_LPSPI0_PCS1 (SpiExternalDevice):
        SpiSlaveMode = false
        SpiBaudrate = 100000
        SpiBaudrateAlternate = 100000
        SpiCsIdentifier = PCS1
        SpiCsPolarity = LOW
        SpiDataShiftEdge = LEADING
        SpiEnableCs = true
        SpiHwUnit = CSIB0
        SpiShiftClockIdleLevel = LOW
        SpiTimeClk2Cs = 0.0001
        SpiTimeCs2Clk = 0.0001
        SpiTimeCs2Cs = 0.0001
        SpiCsContinous = TRUE
        SpiByteSwap = FALSE
        SpiCsSelection = CS_VIA_PERIPHERAL_ENGINE
      SpiJob_LPSPI0_1 (SpiJob): SpiJobId=3, SpiJobPriority=3, SpiHwUnitSynchronous=ASYNCHRONOUS, SpiDeviceAssignment=SpiExternalDevice_LPSPI0_PCS1
        SpiChannelList_0 (SpiChannelList): SpiChannelIndex=0, SpiChannelAssignment=SpiChannel_test5
      SpiSequence_2 (SpiSequence): SpiInterruptibleSequence=false, SpiSequenceId=2, SpiJobAssignment=SpiJob_LPSPI0_1, SpiJobAssignment=SpiJob_LPSPI0_0
      SpiChannel_test4 (SpiChannel): SpiChannelId=4, SpiChannelType=EB, SpiDataWidth=8, SpiTransferWidth=1, SpiEbMaxLength=4, SpiIbNBuffers=1, SpiTransferStart=MSB
      SpiChannel_test5 (SpiChannel): SpiChannelId=5, SpiChannelType=EB, SpiDataWidth=8, SpiTransferWidth=1, SpiEbMaxLength=4, SpiIbNBuffers=1, SpiTransferStart=MSB
    SpiGeneral:
      SpiCancelApi = true
      SpiChannelBuffersAllowed = 1
      SpiDevErrorDetect = true
      SpiGlobalDmaEnable = false
      SpiHwStatusApi = true
      SpiInterruptibleSeqAllowed = false
      SpiLevelDelivered = 2
      SpiOptimizeOneJobSequences = false
      SpiOptimizedChannelsNumber = 0
      SpiOptimizedSeqNumber = 0
      SpiSupportConcurrentSyncTransmit = false
      SpiTransmitTimeout = 50000
      SpiVersionInfoApi = true
      SpiMainFunctionPeriod = 1
      SpiCPUClockRef = McuClockReferencePoint_SBC_SPI
      SpiPhyUnit_LPSPI_0 (SpiPhyUnit):
        SpiPhyUnitMapping = LPSPI_0
        SpiPhyUnitMode = SPI_MASTER
        SpiPhyUnitSync = false
        SpiPhyUnitAsyncMethod = PIO_FIFO
        SpiPhyUnitClockRef = McuClockReferencePoint_LPSPI_0
      SpiPhyUnit_LPSPI_1 (SpiPhyUnit):
        SpiPhyUnitMapping = LPSPI_1
        SpiPhyUnitMode = SPI_MASTER
        SpiPhyUnitSync = true
        SpiPhyUnitAsyncMethod = PIO_FIFO
        SpiPhyUnitClockRef = McuClockReferencePoint_LPSPI_1
    SpiNonAUTOSAR:
      SpiAllowBigSizeCollections = false
      SpiDisableDemReportErrorStatus = false
      SpiEnableHWUnitAsyncMode = true
      SpiEnableUserModeSupport = false
      SpiJobStartNotificationEnable = false
    SpiPublishedInformation: SpiMaxHwUnit=0
