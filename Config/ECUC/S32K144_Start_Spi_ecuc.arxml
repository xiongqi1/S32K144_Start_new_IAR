AUTOSAR XML (schema 4-2-1)
package /Spi
  module config Spi: implementation-config-variant=VARIANT-PRE-COMPILE, module-description=Spi_Impl
    CommonPublishedInformation:
      ArReleaseMajorVersion = 4
      ArReleaseMinorVersion = 2
      ArReleaseRevisionVersion = 2
      ModuleId = 83
      SwMajorVersion = 1
      SwMinorVersion = 0
      SwPatchVersion = 1
      VendorId = 43
    SpiDriver: SpiMaxChannel=4, SpiMaxJob=4, SpiMaxSequence=2
      SpiChannel_test0 (SpiChannel): SpiChannelId=0, SpiChannelType=EB, SpiDataWidth=8, SpiEbMaxLength=4, SpiIbNBuffers=1, SpiTransferStart=MSB, SpiTransferWidth=1
      SpiExternalDevice_PCS3 (SpiExternalDevice):
        SpiBaudrate = 100000
        SpiBaudrateAlternate = 100000
        SpiByteSwap = FALSE
        SpiCsContinous = TRUE
        SpiCsIdentifier = PCS3
        SpiCsPolarity = LOW
        SpiDataShiftEdge = LEADING
        SpiEnableCs = true
        SpiHwUnit = CSIB0
        SpiShiftClockIdleLevel = LOW
        SpiSlaveMode = false
        SpiTimeClk2Cs = 0.0001
        SpiTimeCs2Clk = 0.0001
        SpiTimeCs2Cs = 0.0001
        SpiCsSelection = CS_VIA_PERIPHERAL_ENGINE
      SpiJob_0 (SpiJob): SpiHwUnitSynchronous=SYNCHRONOUS, SpiJobId=0, SpiJobPriority=0, SpiDeviceAssignment=SpiExternalDevice_PCS3
        SpiChannelList_0 (SpiChannelList): SpiChannelIndex=0, SpiChannelAssignment=SpiChannel_test0
      SpiSequence_0 (SpiSequence): SpiInterruptibleSequence=false, SpiSequenceId=0, SpiJobAssignment=SpiJob_3, SpiJobAssignment=SpiJob_2
      SpiChannel_test1 (SpiChannel): SpiChannelId=1, SpiChannelType=EB, SpiDataWidth=16, SpiTransferWidth=1, SpiEbMaxLength=5, SpiIbNBuffers=1, SpiTransferStart=MSB
      SpiExternalDevice_PCS0 (SpiExternalDevice):
        SpiSlaveMode = false
        SpiBaudrate = 100000
        SpiBaudrateAlternate = 100000
        SpiCsIdentifier = PCS0
        SpiCsPolarity = LOW
        SpiDataShiftEdge = LEADING
        SpiEnableCs = true
        SpiHwUnit = CSIB0
        SpiShiftClockIdleLevel = LOW
        SpiTimeClk2Cs = 0.0001
        SpiTimeCs2Clk = 0.0001
        SpiTimeCs2Cs = 0.0001
        SpiCsContinous = TRUE
        SpiByteSwap = FALSE
        SpiCsSelection = CS_VIA_PERIPHERAL_ENGINE
      SpiJob_1 (SpiJob): SpiJobId=1, SpiJobPriority=1, SpiHwUnitSynchronous=SYNCHRONOUS, SpiDeviceAssignment=SpiExternalDevice_PCS0
        SpiChannelList: SpiChannelIndex=0, SpiChannelAssignment=SpiChannel_test1
      SpiExternalDevice_PCS1 (SpiExternalDevice):
        SpiSlaveMode = false
        SpiBaudrate = 100000
        SpiBaudrateAlternate = 100000
        SpiCsIdentifier = PCS1
        SpiCsPolarity = LOW
        SpiDataShiftEdge = LEADING
        SpiEnableCs = true
        SpiHwUnit = CSIB0
        SpiShiftClockIdleLevel = LOW
        SpiTimeClk2Cs = 0.0001
        SpiTimeCs2Clk = 0.0001
        SpiTimeCs2Cs = 0.0001
        SpiCsContinous = TRUE
        SpiByteSwap = FALSE
        SpiCsSelection = CS_VIA_PERIPHERAL_ENGINE
      SpiExternalDevice_PCS2 (SpiExternalDevice):
        SpiSlaveMode = false
        SpiBaudrate = 100000
        SpiBaudrateAlternate = 100000
        SpiCsIdentifier = PCS2
        SpiCsPolarity = LOW
        SpiDataShiftEdge = LEADING
        SpiEnableCs = true
        SpiHwUnit = CSIB0
        SpiShiftClockIdleLevel = LOW
        SpiTimeClk2Cs = 0.0001
        SpiTimeCs2Clk = 0.0001
        SpiTimeCs2Cs = 0.0001
        SpiCsContinous = TRUE
        SpiByteSwap = FALSE
        SpiCsSelection = CS_VIA_PERIPHERAL_ENGINE
      SpiJob_2 (SpiJob): SpiJobId=2, SpiJobPriority=2, SpiHwUnitSynchronous=SYNCHRONOUS, SpiDeviceAssignment=SpiExternalDevice_PCS1
        SpiChannelList: SpiChannelIndex=0, SpiChannelAssignment=SpiChannel_test2
      SpiJob_3 (SpiJob): SpiJobId=3, SpiJobPriority=3, SpiHwUnitSynchronous=SYNCHRONOUS, SpiDeviceAssignment=SpiExternalDevice_PCS2
        SpiChannelList: SpiChannelIndex=0, SpiChannelAssignment=SpiChannel_test3
      SpiSequence_1 (SpiSequence): SpiInterruptibleSequence=false, SpiSequenceId=1, SpiJobAssignment=SpiJob_1, SpiJobAssignment=SpiJob_0
      SpiChannel_test2 (SpiChannel): SpiChannelId=2, SpiChannelType=EB, SpiDataWidth=8, SpiTransferWidth=1, SpiEbMaxLength=6, SpiIbNBuffers=1, SpiTransferStart=MSB
      SpiChannel_test3 (SpiChannel): SpiChannelId=3, SpiChannelType=EB, SpiDataWidth=16, SpiTransferWidth=1, SpiEbMaxLength=4, SpiIbNBuffers=1, SpiTransferStart=MSB
    SpiGeneral:
      SpiCancelApi = true
      SpiChannelBuffersAllowed = 1
      SpiDevErrorDetect = true
      SpiGlobalDmaEnable = false
      SpiHwStatusApi = true
      SpiInterruptibleSeqAllowed = false
      SpiLevelDelivered = 0
      SpiOptimizeOneJobSequences = false
      SpiOptimizedChannelsNumber = 0
      SpiOptimizedSeqNumber = 0
      SpiSupportConcurrentSyncTransmit = false
      SpiTransmitTimeout = 50000
      SpiVersionInfoApi = true
      SpiCPUClockRef = McuClockReferencePoint_LPSPI1
      SpiPhyUnit_LPSPI_1 (SpiPhyUnit):
        SpiPhyUnitAsyncMethod = PIO_FIFO
        SpiPhyUnitMapping = LPSPI_1
        SpiPhyUnitMode = SPI_MASTER
        SpiPhyUnitSync = true
        SpiPhyUnitClockRef = McuClockReferencePoint_LPSPI1
    SpiNonAUTOSAR:
      SpiAllowBigSizeCollections = false
      SpiDisableDemReportErrorStatus = false
      SpiEnableHWUnitAsyncMode = false
      SpiEnableUserModeSupport = false
      SpiJobStartNotificationEnable = false
    SpiPublishedInformation: SpiMaxHwUnit=0
