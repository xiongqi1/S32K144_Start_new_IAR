AUTOSAR XML (schema 4-2-1)
package /ActiveEcuC
  module config WdgM: implementation-config-variant=VARIANT-PRE-COMPILE, module-description=WdgM_Impl
    WdgMConfigSet: WdgMInitialMode=WdgMMode
      WdgMMode:
        WdgMExpiredSupervisionCycleTol = 5
        WdgMModeId = 0
        WdgMSupervisionCycle = 0.05
        WdgMInitialTriggerModeId = 0
        WdgMModeCoreAssignment = 0
        WdgMTicksPerSecond = 20
        WdgMReportStatusViaRte = true
        WdgMTrigger: WdgMWatchdogMode=WDGIF_FAST_MODE, WdgMTriggerConditionValue=200, WdgMTriggerModeId=0, WdgMTriggerWatchdogRef=WdgMWatchdog
        WdgMDeadlineSupervision: WdgMDeadlineMax=0.05, WdgMDeadlineMin=0.002, WdgMDeadlineStartRef=WdgMCheckpoint_1, WdgMDeadlineStopRef=WdgMCheckpoint_2
        WdgMLocalStatusParams_001 (WdgMLocalStatusParams):
          WdgMFailedAliveSupervisionRefCycleTol = 3
          WdgMSupervisedEntityInitialMode = WDGM_LOCAL_STATUS_OK
          WdgMFailedDeadlineRefCycleTol = 0
          WdgMDeadlineReferenceCycle = 0
          WdgMFailedProgramFlowRefCycleTol = 10
          WdgMProgramFlowReferenceCycle = 12
          WdgMLocalStatusSupervisedEntityRef = WdgMSupervisedEntity_LedTask
        WdgMAliveSupervision_001 (WdgMAliveSupervision):
          WdgMExpectedAliveIndications = 1
          WdgMMaxMargin = 1
          WdgMMinMargin = 1
          WdgMSupervisionReferenceCycle = 7
          WdgMAliveSupervisionCheckpointRef = WdgMCheckpoint_1
      WdgMDemEventParameterRefs
    WdgMGeneral:
      WdgMDevErrorDetect = true
      WdgMDemReport = false
      WdgMImmediateReset = true
      WdgMOffModeEnabled = false
      WdgMVersionInfoApi = false
      WdgMDefensiveBehavior = false
      WdgMUseRte = true
      WdgMDemSupervisionReport = false
      WdgMFirstCycleAliveCounterReset = false
      WdgMAutosarDebugging = false
      WdgMUseOsSuspendInterrupt = true
      WdgMTimebaseSource = WDGM_INTERNAL_SOFTWARE_TICK
      WdgMSecondResetPath = true
      WdgMTickOverrunCorrection = false
      WdgMEntityDeactivationEnabled = false
      WdgMGenerateCPIdAsPortDefinedArgument = false
      WdgMStatusReportingMechanism = WDGM_USE_MODE_SWITCH_PORTS
      WdgMCallerIds: WdgMCallerId=0
      WdgMWatchdog: WdgMWatchdogName=, WdgMWatchdogDeviceRef=WdgIfDevice
      WdgMSupervisedEntity_LedTask (WdgMSupervisedEntity):
        WdgMSupervisedEntityId = 0
        WdgMEnableEntityDeactivation = false
        WdgMReportStatusViaRte = true
        WdgMInternalCheckpointInitialRef = WdgMCheckpoint_1
        WdgMInternallCheckpointFinalRef = WdgMCheckpoint_2
        WdgMCheckpoint_1 (WdgMCheckpoint): WdgMCheckpointId=0
        WdgMCheckpoint_2 (WdgMCheckpoint): WdgMCheckpointId=1
        WdgMInternalTransition: WdgMInternalTransitionDestRef=WdgMCheckpoint_2, WdgMInternalTransitionSourceRef=WdgMCheckpoint_1
