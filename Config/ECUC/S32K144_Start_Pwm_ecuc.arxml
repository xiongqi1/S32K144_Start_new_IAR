AUTOSAR XML (schema 4-2-1)
package /ActiveEcuC
  module config Pwm: implementation-config-variant=VARIANT-PRE-COMPILE, module-description=Pwm_Impl
    PwmConfigurationOfOptApiServices:
      PwmDeInitApi = true
      PwmGetOutputState = true
      PwmSetDutyCycle = true
      PwmSetOutputToIdle = true
      PwmSetPeriodAndDuty = true
      PwmVersionInfoApi = true
      PwmGetChannelStateApi = false
      PwmForceOutputToZeroApi = false
      PwmSetDutyCycle_NoUpdate = false
      PwmSetPeriodAndDuty_NoUpdate = false
      PwmSetPhaseShift = false
      PwmSetPhaseShiftNoUpdate = false
      PwmEnableTrigger = false
      PwmDisableTrigger = false
      PwmSwResetCounter = false
    PwmChannelConfigSet
      PwmChannel_1 (PwmChannel):
        PwmChannelId = 0
        PwmPeriodInTicks = true
        PwmPeriodDefault = 8000
        PwmPolarity = PWM_LOW
        PwmDutycycleDefault = 16384
        PwmIdleState = PWM_HIGH
        PwmChannelClass = PWM_VARIABLE_PERIOD
        PwmFtmChannel = PwmFtmChannels_CH2
        PwmMcuClockReferencePoint = McuClockReferencePoint_FTM0
      PwmFtmModule:
        FtmModule = FTM_0
        PwmPrescaler = PRESC_1
        PwmPrescaler_Alternate = PRESC_1
        PwmClockSelection = PWM_SYSTEM_CLOCK
        PwmChanEdgeAlignment = PWM_CENTER_ALIGNED
        PwmUpdatedEndPeriod = true
        PwmUpdatedMiddlePeriod = false
        PwmReloadFrequency = LDFQ_EACH1
        PwmBDMEnable = CNT_STOPED_FLAG_SET
        PwmFtmFaultFunctionality = FLTCTRL_DISABLED
        PwmFtmChannelFaultSettings:
          PwmFilterValue = 0
          PwmDisableOutputOnFault{0..3} = false
          PwmFtmFaultOutputState = SAFE_VALUES
          PwmFtmChannelFault{0..3}Settings: PwmFault{0..3}Polarity=false, PwmEnableFault{0..3}Filter=false, PwmFault{0..3}Notification=NULL
        PwmExternalTriggerSettings:
          PwmEnableExternalTriggerChannel{0..7} = false
          PwmEnableInitializationTrigger = false
        PwmFtmChannels_CH2 (PwmFtmChannels): PwmFtmChannelId=FTM_0_CH_2, ChannelEdgeSetup=INDEPENDENT, PwmPhaseShift=0, ChannelCombDeadTimeEn=false
    PwmGeneral:
      PwmDevErrorDetect = true
      PwmDutycycleUpdatedEndperiod = true
      PwmNotificationSupported = true
      PwmEnableDualClockMode = false
      PwmCommonTimebaseSupported = false
      PwmPeriodUpdatedEndperiod = true
      PwmEnableUserModeSupport = false
      PwmIndex = 0
      PwmFaultSupport = false
      PwmFtmEnableExtTrigger = false
      PwmEnablePhaseShift = false
      EnableMaskingOperations = false
      PwmMultiChannelSynch = false
      40 x PwmHwConfiguration, all with PwmInterruptEnable=false:
        PwmHwConfiguration: PwmInterruptHwId=PWM_FTM_0_CH_2_ISR, PwmChannelIsUsed=true
        PwmHwConfiguration_{1..39}: PwmInterruptHwId=PWM_FTM_0_CH_1_ISR, PwmChannelIsUsed=false
    CommonPublishedInformation:
      ArReleaseMajorVersion = 4
      ArReleaseMinorVersion = 2
      ArReleaseRevisionVersion = 2
      ModuleId = 121
      SwMajorVersion = 1
      SwMinorVersion = 0
      SwPatchVersion = 1
      VendorId = 43
