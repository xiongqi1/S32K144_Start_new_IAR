AUTOSAR XML (schema 4-2-1)
package /ActiveEcuC
  module config Adc: implementation-config-variant=VARIANT-PRE-COMPILE, module-description=Adc_Impl
    AdcConfigSet
      AdcHwUnit_ADC0 (AdcHwUnit):
        AdcTransferType = ADC_INTERRUPT
        AdcHwUnitId = ADC0
        AdcLogicalUnitId = 0
        AdcVoltageReferenceSelection = VREFH_VREFL
        AdcResolution = BITS_12
        AdcOffsetCorrectionValue = 0
        AdcClockSource = ADC_ALTCLK1
        AdcPrescale = 1
        AdcChannel_CH2 (AdcChannel): AdcLogicalChannelId=0, AdcChannelId=AN_2
        AdcGroup1 (AdcGroup):
          AdcGroupAccessMode = ADC_ACCESS_MODE_SINGLE
          AdcGroupConversionMode = ADC_CONV_MODE_ONESHOT
          AdcGroupConversionType = ADC_CONV_TYPE_NORMAL
          AdcGroupId = 0
          AdcGroupTriggSrc = ADC_TRIGG_SRC_SW
          AdcExtraNotification = NULL_PTR
          AdcStreamingBufferMode = ADC_STREAM_BUFFER_LINEAR
          AdcEnableDoubleBuffering = false
          AdcEnableHalfInterrupt = false
          AdcStreamingNumSamples = 1
          AdcWithoutInterrupts = false
          AdcGroupInBacktoBackMode = true
          AdcGroupUsesChannelDelays = false
          AdcDelayNextPdb = 0
          AdcPdbPeriodContinuousMode = 0
          AdcNotification = AdcGroup1_ConvertCompleteNotification
          AdcGroupDefinition = AdcChannel_CH2
    AdcGeneral:
      AdcDeInitApi = true
      AdcDevErrorDetect = true
      AdcEnableLimitCheck = false
      AdcEnableQueuing = true
      AdcEnableStartStopGroupApi = true
      AdcGrpNotifCapability = true
      AdcHwTriggerApi = false
      AdcReadGroupApi = true
      AdcVersionInfoApi = true
      AdcPriorityImplementation = ADC_PRIORITY_NONE
      AdcResultAlignment = ADC_ALIGN_RIGHT
      AdcTimeout = 65535
      AdcDmaTimeout = 65535
      AdcPriorityQueueMaxDepth = 1
    AdcInterrupt: AdcInterruptSource=ADC0_COCO, AdcInterruptEnable=true
    AdcInterrupt_1 (AdcInterrupt): AdcInterruptSource=ADC1_COCO, AdcInterruptEnable=false
    AdcPublishedInformation: AdcChannelValueSigned=false, AdcGroupFirstChannelFixed=false, AdcMaxChannelResolution=12
    CommonPublishedInformation:
      ArReleaseMajorVersion = 4
      ArReleaseMinorVersion = 2
      ArReleaseRevisionVersion = 2
      ModuleId = 123
      SwMajorVersion = 1
      SwMinorVersion = 0
      SwPatchVersion = 1
      VendorApiInfix = 
      VendorId = 43
    NonAutosar:
      AdcEnableGroupDependentChannelNames = false
      AdcEnableDualClockMode = false
      AdcEnableCalibration = false
      AdcEnableSetChannel = false
      AdcEnableInitialNotification = false
      AdcDisableDemReportErrorStatus = false
      AdcConvTimeOnce = false
      AdcOptimizeOneShotHwTriggerConversions = false
      AdcEnableDoubleBufferingOptimization = false
      DoubleBufferingMoreThanOneChannel = false
      AdcEnableDmaTrasferMode = false
      AdcUseHardwareNormalGroups = false
      AdcEnableUserModeSupport = false
      AdcBypassConsistencyLoop = false
      AdcContinuousWithoutInterrupt = false
