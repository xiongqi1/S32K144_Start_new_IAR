AUTOSAR XML (schema 4-2-1)
package /ActiveEcuC
  ecuc value collection ActiveEcuC: ecu-extract=SYSTEM
    ecuc-values:
      Port
      Resource
      Dio
      vSet
      Mcu
      Com
      Rte
      EcuM
      Os
      PduR
      CanSM
      Dcm
      CanTp
      Can
      CanIf
      Det
      ComM
      EcuC
      BswM
      Dem
      Base
      Spi
      Adc
      Gpt
      Wdg
      WdgIf
      WdgM
