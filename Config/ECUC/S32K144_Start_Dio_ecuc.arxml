AUTOSAR XML (schema 4-2-1)
package /Dio
  module config Dio: implementation-config-variant=VARIANT-PRE-COMPILE, module-description=Dio_Impl
    CommonPublishedInformation:
      ArReleaseMajorVersion = 4
      ArReleaseMinorVersion = 2
      ArReleaseRevisionVersion = 2
      ModuleId = 120
      SwMajorVersion = 1
      SwMinorVersion = 0
      SwPatchVersion = 1
      VendorId = 43
    DioConfig
      3 x DioPort:
        DioPort_0: DioPortId=3
          4 x DioChannel:
            DioChannel_PTD16: DioChannelId=16
            DioChannel_PTD0: DioChannelId=0
            DioChannel_PTD1: DioChannelId=1
            DioChannel_PTD15: DioChannelId=15
        DioPort_PTB: DioPortId=1
          DioChannel_PTB2 (DioChannel): DioChannelId=2
        DioPort_PTC: DioPortId=2
          DioChannel_PTC12 (DioChannel): DioChannelId=12
          DioChannel_PTC13 (DioChannel): DioChannelId=13
    DioGeneral:
      DioDevErrorDetect = false
      DioEnableUserModeSupport = false
      DioFlipChannelApi = true
      DioMaskedWritePortApi = false
      DioReadZeroForUndefinedPortPins = false
      DioReversePortBits = false
      DioVersionInfoApi = false
