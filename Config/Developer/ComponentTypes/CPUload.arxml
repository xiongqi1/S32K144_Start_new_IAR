AUTOSAR XML (schema 00044)
package /ComponentTypes
  application sw component type CPUload
    behavior CPUload_InternalBehavior
      timing event TMT_CPUload_Runnable_1s: start-on-event=CPUload_Runnable_1s, period=1
      runnable CPUload_Runnable_1s: minimum-start-interval=1
  swc implementation CPUload_Implementation: behavior=CPUload_InternalBehavior
