AUTOSAR XML (schema 00044)
package /ComponentTypes
  application sw component type PWL
    behavior PWL_InternalBehavior
      timing event TMT_PWL_Runnable_20ms: start-on-event=PWL_Runnable_20ms, period=0.02
      runnable PWL_Runnable_20ms: minimum-start-interval=0.02
  swc implementation PWL_Implementation: behavior=PWL_InternalBehavior
