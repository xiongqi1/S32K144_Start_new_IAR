AUTOSAR XML (schema 00044)
package /ComponentTypes
  application sw component type DLK
    behavior DLK_InternalBehavior
      timing event TMT_DLK_Runnable_100ms: start-on-event=DLK_Runnable_100ms, period=0.1
      runnable DLK_Runnable_100ms: minimum-start-interval=0.1
  swc implementation DLK_Implementation: behavior=DLK_InternalBehavior
