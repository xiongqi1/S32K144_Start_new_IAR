AUTOSAR XML (schema 00044)
package /ComponentTypes
  application sw component type EMC
    behavior EMC_InternalBehavior
      timing event TMT_EMC_Runnable_10ms: start-on-event=EMC_Runnable_10ms, period=0.01
      runnable EMC_Runnable_10ms: minimum-start-interval=0.01
  swc implementation EMC_Implementation: behavior=EMC_InternalBehavior
