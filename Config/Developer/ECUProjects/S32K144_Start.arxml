AUTOSAR XML (schema 00044)
package /VehicleProject
  system System
    root-software-compositions:
      root sw composition prototype EcuSwComposition: software-composition=ECU_Composition
package /ECUCompositionTypes
  composition sw component type ECU_Composition
    6 x component:
      CpLedTask: type=CtLedTask
      Cdd_SBC_UJA1169: type=CddSbc
      CPUload_SWC: type=CPUload
      DLK_SWC: type=DLK
      EMC_SWC: type=EMC
      PWL_SWC: type=PWL
package /EndToEndProtections
  end to end protection set EndToEndProtectionSet
