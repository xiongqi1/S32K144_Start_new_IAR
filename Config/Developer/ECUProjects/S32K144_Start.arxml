AUTOSAR XML (schema 00044)
package /VehicleProject
  system System
    root-software-compositions:
      root sw composition prototype EcuSwComposition: software-composition=ECU_Composition
package /ECUCompositionTypes
  composition sw component type ECU_Composition
    4 x component:
      CpLedTask: type=CtLedTask
      Cdd_SBC_UJA1169: type=CddSbc
      SWC1: type=Test_SWC1
      SWC2: type=Test_SWC2
    connect SWC2.Test_SR_WriteRead -> SWC1.Test_SR_WriteRead_1
    connect SWC1.Test_SR_WriteRead -> SWC2.Test_SR_WriteRead_1
    connect SWC1.SWC_Service -> SWC2.SWC_Service
    connect SWC1.Test_Record_Interface -> SWC2.Test_Record_Interface
package /EndToEndProtections
  end to end protection set EndToEndProtectionSet
