AUTOSAR XML (schema 4-2-1)
package /TS_T40D2M10I1R0/Gpt_ib_bswmd/BswModuleDescriptions
  bsw module description Gpt
    bsw internal behavior GptBehavior
      65 x exclusive area:
        GPT_EXCLUSIVE_AREA_{00..64}
