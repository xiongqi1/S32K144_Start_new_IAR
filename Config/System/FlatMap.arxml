AUTOSAR XML (schema 4-2-1)
package /COM/VECTOR/CFG/WORKFLOW/SYSDESC/SYNC
  flat map FLATMAP
    6 x flat instance descriptor:
      CpLedTask: upstream-reference=EcuSwComposition.CpLedTask, ecu-extract-reference=COMPOSITIONTYPE.CpLedTask
      Cdd_SBC_UJA1169: upstream-reference=EcuSwComposition.Cdd_SBC_UJA1169, ecu-extract-reference=COMPOSITIONTYPE.Cdd_SBC_UJA1169
      CPUload_SWC: upstream-reference=EcuSwComposition.CPUload_SWC, ecu-extract-reference=COMPOSITIONTYPE.CPUload_SWC
      DLK_SWC: upstream-reference=EcuSwComposition.DLK_SWC, ecu-extract-reference=COMPOSITIONTYPE.DLK_SWC
      EMC_SWC: upstream-reference=EcuSwComposition.EMC_SWC, ecu-extract-reference=COMPOSITIONTYPE.EMC_SWC
      PWL_SWC: upstream-reference=EcuSwComposition.PWL_SWC, ecu-extract-reference=COMPOSITIONTYPE.PWL_SWC
