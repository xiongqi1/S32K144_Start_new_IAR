AUTOSAR XML (schema 00044)
package /COM/VECTOR/CFG/WORKFLOW/SYSDESC/SYNC
  system SYSTEM: category=ECU_EXTRACT
    system mapping MAPPINGS
    root-software-compositions:
      root sw composition prototype COMPOSITIONTYPE: flat-map=FLATMAP, software-composition=COMPOSITIONTYPE
  composition sw component type COMPOSITIONTYPE  # UB:Derived from original system description
    12 x component:
      BswM: type=BswM
      ComM: type=ComM
      Det: type=Det
      EcuM: type=EcuM
      Os_OsCore0_swc: type=Os_OsCore0_swc
      DemMaster_0: type=DemMaster_0
      DemSatellite_0: type=DemSatellite_0
      Dcm: type=Dcm
      CpLedTask: type=CtLedTask
      Cdd_SBC_UJA1169: type=CddSbc
      SWC1: type=Test_SWC1
      SWC2: type=Test_SWC2
    connect BswM.Switch_ESH_ModeSwitch -> BswM.Notification_ESH_ModeNotification
    connect ComM.UR_CN_CAN00_06ecbb07 -> CpLedTask.UR_CN_CAN00_06ecbb07
    connect SWC2.Test_SR_WriteRead -> SWC1.Test_SR_WriteRead_1  # UB:Derived from original system description
    connect SWC1.Test_SR_WriteRead -> SWC2.Test_SR_WriteRead_1  # UB:Derived from original system description
    connect SWC1.SWC_Service -> SWC2.SWC_Service  # UB:Derived from original system description
    connect SWC1.Test_Record_Interface -> SWC2.Test_Record_Interface  # UB:Derived from original system description
  end to end protection set E2EPROTECTIONSET
  port interface mapping set PORTINTERFACEMAPPINGSET
